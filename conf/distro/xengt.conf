## conf/distro/xengt.conf
```bitbake
DISTRO_VERSION = "v0"

#Images built can have to modes:
# 'debug': empty rootpassword, strace included
# 'release' no root password, no strace and gdb by default
DISTRO_TYPE ?= "debug"
#DISTRO_TYPE = "release"

# We want to ship extra debug utils in the rootfs when doing a debug build
DEBUG_APPS ?= ""
DEBUG_APPS += '${@base_conditional("DISTRO_TYPE", "release", "", "strace procps",d)}'

DISTRO_FEATURES_append = " \
    efi \
    ldconfig \
    opengl \
    pam \
    systemd \
    virtualization \
    vulkan \
    wayland \
    xattr \
    xen \
"

DISTRO_FEATURES_remove = "sysvinit"

VIRTUAL-RUNTIME_init_manager = "systemd"

PACKAGECONFIG_pn-systemd = " \
    ${@bb.utils.filter('DISTRO_FEATURES', 'efi ldconfig pam selinux usrmerge', d)} \
    ${@bb.utils.contains('DISTRO_FEATURES', 'wifi', 'rfkill', '', d)} \
    ${@bb.utils.contains('DISTRO_FEATURES', 'x11', 'xkbcommon', '', d)} \
    backlight \
    binfmt \
    cryptsetup \
    firstboot \
    hibernate \
    hostnamed \
    ima \
    iptc \
    localed \
    logind \
    machined \
    myhostname \
    networkd \
    nss \
    polkit \
    quotacheck \
    randomseed \
    resolved \
    serial-getty-generator \
    smack \
    sysusers \
    timedated \
    timesyncd \
    utmp \
    vconsole \
    xz \
"

PACKAGECONFIG_pn-qemu = " \
    alsa \
    fdt \
    glx \
    gtk+ \
    libusb \
    sdl \
    xen \
"

PREFERRED_PROVIDER_virtual/kernel = "linux-gvtg"

################################
# HACKS AND UPSTREAM WORKAROUNDS
################################
PACKAGECONFIG_append_pn-qemu = " gvtg"
PREFERRED_VERSION_qemu = "git"

# libdevmapper relies on udev, which is sytemd
# we configure systemd to rely on cryptsetup which relies on libdevmapper
# UPSTREAM-STATUS: https://patchwork.openembedded.org/patch/140207/
PACKAGECONFIG_pn-lvm2 = "odirect dmeventd lvmetad thin-provisioning-tools \
    ${@bb.utils.filter('DISTRO_FEATURES', 'selinux', d)} \
"
PACKAGECONFIG_pn-libdevmapper = "odirect dmeventd lvmetad thin-provisioning-tools \
    ${@bb.utils.filter('DISTRO_FEATURES', 'selinux', d)} \
"

# qemu requires gettext
# UPSTREAM-STATUS: https://patchwork.openembedded.org/patch/150703/
DEPENDS_append_pn-qemu = " gettext-native"
DEPENDS_append_pn-qemu-native = " gettext-native"
```

## conf/layer.conf
```bitbake
# We have a conf and classes directory, append to BBPATH
BBPATH .= ":${LAYERDIR}"

# We have a recipes directory, add to BBFILES
BBFILES += "${LAYERDIR}/recipes*/*/*.bb ${LAYERDIR}/recipes*/*/*.bbappend"

BBFILE_COLLECTIONS += "gvtg"
BBFILE_PATTERN_gvtg := "^${LAYERDIR}/"
BBFILE_PRIORITY_gvtg = "8"

# This should only be incremented on significant changes that will
# cause compatibility issues with other layers
LAYERVERSION_gvtg = "1"
LAYERSERIES_COMPAT_gvtg = "sumo"
LAYERDEPENDS_gvtg = "core"
```
